## CMakeLists.txt
```
cmake_minimum_required(VERSION 3.20.0)
find_package(Zephyr REQUIRED HINTS $ENV{ZEPHYR_BASE})
project(riepilogo_modulo2)

target_sources(app PRIVATE src/main.c)
```

## Kconfig
```
# Opzioni proprie dell'esercizio di riepilogo del Modulo 2.
#
# TODO: aggiungi l'opzione CORSO_PERIODO_MS
#   - int, descrizione "Mezzo periodo del lampeggio in millisecondi"
#   - default 500
#   - range 100 5000
#   - un help di una riga

source "Kconfig.zephyr"
```

## prj.conf
```kconfig
# Logging (LOG_INF, ...).
CONFIG_LOG=y
# Driver GPIO per il LED.
CONFIG_GPIO=y

# TODO: imposta CONFIG_CORSO_PERIODO_MS=800 (dopo averla definita nel file Kconfig)
```

## app.overlay
```dts
/*
 * TODO: aggiungi l'alias "lampeggio" che punta al LED arancione (etichetta orange_led_3,
 * pin PD13, e' il LED dell'alias led1).
 *
 * Etichette dei LED della stm32f4_disco: green_led_4 (PD12), orange_led_3 (PD13),
 * red_led_5 (PD14), blue_led_6 (PD15).
 */

/ {
};
```

## src/main.c
```c
/*
 * Esercizio 8 (Modulo 2) - Riepilogo: lampeggio configurabile
 *
 * Teoria: teoria/03_build_kconfig_devicetree.md, tutto (sezione 10 per il riassunto).
 *
 * OBIETTIVO
 * Mettere insieme gli strumenti del modulo: un LED che lampeggia con
 *   - il LED scelto dal devicetree (alias "lampeggio" nell'overlay -> LED arancione),
 *   - il periodo scelto da Kconfig (opzione tua CORSO_PERIODO_MS),
 *   - i messaggi scritti con il logging.
 * Il codice non contiene ne' numeri di pin ne' tempi: solo nomi.
 *
 * PASSI
 * 1. File Kconfig: definisci CORSO_PERIODO_MS (istruzioni nel file).
 * 2. prj.conf: imposta CONFIG_CORSO_PERIODO_MS=800.
 * 3. app.overlay: alias lampeggio = &orange_led_3;  (LED arancione, PD13).
 * 4. Nel codice:
 *      - registra il modulo di log "riepilogo" con livello INF;
 *      - crea la gpio_dt_spec da DT_ALIAS(lampeggio);
 *      - controlla che sia pronta e configurala come uscita spenta; in caso di errore
 *        usa LOG_ERR e termina;
 *      - stampa con LOG_INF "Periodo: %d ms" (il valore di Kconfig);
 *      - ciclo infinito: accendi -> LOG_INF("LED acceso") -> k_msleep(periodo)
 *                        spegni  -> LOG_INF("LED spento") -> k_msleep(periodo)
 * 5. Ricompila con -Pulito, esegui, controlla il LED in Renode
 *    (sysbus.gpioPortD.led1 State).
 * 6. Prova a cambiare solo prj.conf (es. 300) o solo l'overlay (&blue_led_6): il
 *    codice non cambia. Rimetti 800 e &orange_led_3 prima della verifica.
 * 7. Lancia la verifica.
 *
 * OUTPUT ATTESO
 *     [..] <inf> riepilogo: Periodo: 800 ms
 *     [..] <inf> riepilogo: LED acceso
 *     [..] <inf> riepilogo: LED spento
 *     ...
 *
 * CONCETTI NUOVI
 * - Nessuno: e' un esercizio di sintesi. Separare "cosa fa il codice" (main.c),
 *   "con quali parametri software" (Kconfig/prj.conf) e "su quale hardware"
 *   (devicetree/overlay) e' il modo di lavorare di Zephyr.
 *
 * COME VERIFICARE DA SOLO
 *     .\verifica.ps1 modulo2\08_riepilogo -Pulito
 *
 * ERRORI TIPICI
 * - Uno dei tre file non aggiornato: leggi il primo errore, ti dice se manca
 *   CONFIG_CORSO_PERIODO_MS (Kconfig/prj.conf) o DT_N_ALIAS_lampeggio (overlay).
 * - Log scritto prima di cambiare il LED: la verifica legge lo stato appena vede
 *   la riga.
 *
 * BONUS (facoltativo)
 * - Aggiungi un'opzione bool CORSO_LAMPEGGIO_DEBUG: se attiva, stampa con LOG_DBG
 *   anche il numero del giro (ricorda di alzare il livello del modulo).
 * - Aggiungi al nodo zephyr,user dell'overlay una proprieta' "ripetizioni" e fai
 *   lampeggiare il LED solo quel numero di volte.
 *
 * Scrivi il tuo codice qui sotto.
 */

#include <zephyr/kernel.h>
#include <zephyr/drivers/gpio.h>
#include <zephyr/logging/log.h>

/* TODO: registrazione del modulo di log e gpio_dt_spec */

int main(void)
{
	/* TODO */

	return 0;
}
```
